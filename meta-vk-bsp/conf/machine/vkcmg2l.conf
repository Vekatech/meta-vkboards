## meta-vk-bsp/conf/machine/vkcmg2l.conf
```bitbake
#@TYPE: Machine
#@NAME: vkcmg2l machine
#@DESCRIPTION: VK-CM/G2L board

require conf/machine/include/arm/armv8-2a/tune-cortexa55.inc
require conf/machine/include/rz-common.inc
require conf/machine/include/rzg2l-family.inc

SERIAL_CONSOLES ?= "115200;ttySC0"
# Trusted Firmware-A configuration
PREFERRED_VERSION_trusted-firmware-a ?= "2.10%"
TFA_PLATFORM ?= "g2l"
TFA_BOARD ?= "vkcmg2l"
TFA_UBOOT ?= "1"

BL2_BASE_ADDR ?= "0x00012000"
TFA_BUILD_TARGET ?= "bl2 bl31"
BL2_BOOT_TARGET ?= "qspi emmc"
TFA_SPI_FLASH ?= "S25FL128L"

BL2_ADJUST_VMA ?= "0x00011E00"
FIP_ADJUST_VMA ?= "0x0000"

# U-Boot Configuration
UBOOT_CONFIG ??= "qspi emmc"
UBOOT_CONFIG[qspi] = "vkcmg2l-qspi_defconfig"
UBOOT_CONFIG[emmc] = "vkcmg2l-emmc_defconfig"

PREFERRED_VERSION_u-boot = "2024.07%"

UENV_FILE ?= "uEnv-vkcmg2l.txt"

# Flash Writer configuration
FLASH_WRITER_BOARD ?= "VKCMG2L"

# Support board with PMIC. Default:yes.
# With this option enabled, build both bin files for PMIC board and Concrete board.
VKBOARD_SUPPORT ?= "1"
CONFIG_WKS_eMMC ?= "1"

CONFIG_WLAN_CYW43439 ?= "1"
CONFIG_UBOOT_CM33CMD ?= "0"
CONFIG_QT_DEMO ?= "0"
CONFIG_GPIO_MCP23x17 ?= "0"

# Supported devicetree
KERNEL_DTS = " \
    vkcmg2l/vkcmg2l.dts \
"
KERNEL_DEVICETREE = ""

KERNEL_DTSI = ""

KERNEL_DEVICETREE_OVERLAY  = " \
    vkcmg2l/overlays/vkcmx2l-carrier.dts \
    vkcmg2l/overlays/vkrz-cm33.dts \
    vkcmg2l/overlays/vkrz-dsi-kd070hdfia030.dts \
    vkcmg2l/overlays/vkrz-dsi-kd101wxfid045.dts \
    vkcmg2l/overlays/vkrz-exp-riic2_100.dts \
    vkcmg2l/overlays/vkrz-exp-riic2_400.dts \
    vkcmg2l/overlays/vkrz-exp-rspi1.dts \
    vkcmg2l/overlays/vkrz-exp-scfi3.dts \
    vkcmg2l/overlays/vkrz-dsi-to-lvds.dts \
"

# Wic image
WKS_FILE = " ${@oe.utils.conditional("CONFIG_WKS_eMMC", "1", "image-vkboard-mmc.wks", "image-vkrboard-esd.wks", d)} "


IMAGE_BOOT_FILES = " \
	bl2_bp_qspi-${MACHINE}.bin \
	bl2_bp_emmc-${MACHINE}.bin \
	fip_emmc-${MACHINE}.bin \
    fip_qspi-${MACHINE}.bin \
	bl2_bp_qspi-${MACHINE}.srec \
	bl2_bp_emmc-${MACHINE}.srec \
	fip_emmc-${MACHINE}.srec \
	fip_qspi-${MACHINE}.srec \
	Flash_Writer_SCIF_VKCMG2L_DDR4_2GB_1PCS.mot \
"

# Deploy the uEnv.txt to the /boot directory
WKS_FILE_DEPENDS:append = " uenv"
IMAGE_BOOT_FILES += " uEnv.txt"
IMAGE_BOOT_FILES += " readme.txt"

IMAGE_BOOT_FILES += " ${KERNEL_IMAGETYPE} vkcmg2l.dtb "

# Support DTB Overlay files
IMAGE_BOOT_FILES += " overlays/*;overlays/"

#IMAGE_FSTYPES += " wic "
IMAGE_FSTYPES:remove = "tar.gz tar.bz2 wic.gz wic.bz2"
IMAGE_FSTYPES:append = " tar.xz wic wic.xz wic.bmap"

do_image_wic[depends] += "firmware-pack:do_deploy flash-writer:do_deploy"

MACHINE_FEATURES:append = " mali-g31 hwh264dec hwh264enc"

MACHINE_EXTRA_RRECOMMENDS:append = " kernel-modules"
```

## meta-vk-bsp/conf/machine/vkrzg2ul.conf
```bitbake
#@TYPE: Machine
#@NAME: vkrzg2ul machine
#@DESCRIPTION: VK-RZ/G2UL board

require conf/machine/include/rzg2l-family.inc
require conf/machine/include/arm/armv8-2a/tune-cortexa55.inc
require conf/machine/include/rz-common.inc

# Trusted Firmware-A configuration
PREFERRED_VERSION_trusted-firmware-a ?= "2.9%"
TFA_PLATFORM ?= "g2ul"
TFA_BOARD ?= "vkrzg2ul SOC_TYPE=1"
TFA_UBOOT ?= "1"
TFA_BUILD_TARGET ?= "bl2 bl31"
BL2_BOOT_TARGET ?= "qspi emmc"
TFA_SPI_FLASH ?= "MX25L12833F"

BL2_ADJUST_VMA ?= "0x00011E00"
FIP_ADJUST_VMA ?= "0x0000"

# U-Boot Configuration
UBOOT_CONFIG ??= "qspi emmc"
UBOOT_CONFIG[qspi] = "vkrzg2ul-qspi_defconfig"
UBOOT_CONFIG[emmc] = "vkrzg2ul-emmc_defconfig"

PREFERRED_VERSION_u-boot = "2021.10%"

UENV_FILE ?= "uEnv-vkrzg2ul.txt"

# Flash Writer configuration
FLASH_WRITER_BOARD ?= "VKRZG2UL"

# Support board with PMIC. Default:yes.
# With this option enabled, build both bin files for PMIC board and Concrete board.
VKBOARD_SUPPORT ?= "1"
CONFIG_WKS_eMMC ?= "1"

CONFIG_WLAN_CYW43439 ?= "0"
CONFIG_UBOOT_CM33CMD ?= "1"


# Supported devicetree
KERNEL_DTS = " \
    vkrzg2ul/vkrzg2ul.dts \
"

KERNEL_DEVICETREE = ""

KERNEL_DEVICETREE_OVERLAY  = " \
    vkrzg2ul/overlays/vkrz-audio.dts \
    vkrzg2ul/overlays/vkrz-cm33.dts \
    vkrzg2ul/overlays/vkrz-exp-i2c2_100.dts \
    vkrzg2ul/overlays/vkrz-exp-i2c2_400.dts \
    vkrzg2ul/overlays/vkrz-exp-i2c3_100.dts \
    vkrzg2ul/overlays/vkrz-exp-i2c3_400.dts \
    vkrzg2ul/overlays/vkrz-exp-scif1.dts \
    vkrzg2ul/overlays/vkrz-exp-scif1_rs485.dts \
    vkrzg2ul/overlays/vkrz-exp-scif3.dts \
    vkrzg2ul/overlays/vkrz-exp-spi0.dts \
    vkrzg2ul/overlays/vkrz-udma.dts \
"

# Wic image
WKS_FILE = " ${@oe.utils.conditional("CONFIG_WKS_eMMC", "1", "image-vkboard-mmc.wks", "image-vkrboard-esd.wks", d)} "


IMAGE_BOOT_FILES = " \
	bl2_bp_qspi-${MACHINE}.bin \
	bl2_bp_emmc-${MACHINE}.bin \
	fip_emmc-${MACHINE}.bin \
    fip_qspi-${MACHINE}.bin \
	bl2_bp_qspi-${MACHINE}.srec \
	bl2_bp_emmc-${MACHINE}.srec \
	fip_emmc-${MACHINE}.srec \
	fip_qspi-${MACHINE}.srec \
	Flash_Writer_SCIF_VKRZG2UL_DDR4_1GB_1PCS.mot \
"

# Deploy the uEnv.txt to the /boot directory
WKS_FILE_DEPENDS:append = " uenv"
IMAGE_BOOT_FILES += " uEnv.txt"
IMAGE_BOOT_FILES += " readme.txt"

IMAGE_BOOT_FILES += " ${KERNEL_IMAGETYPE} vkrzg2ul.dtb "

# Support DTB Overlay files
IMAGE_BOOT_FILES += " overlays/*;overlays/"

#IMAGE_FSTYPES += " wic "
IMAGE_FSTYPES:remove = "tar.gz tar.bz2 wic.gz wic.bz2"
IMAGE_FSTYPES:append = " tar.xz wic wic.xz wic.bmap"

do_image_wic[depends] += "firmware-pack:do_deploy flash-writer:do_deploy"

#MACHINE_FEATURES:append = " mali-g31 "

MACHINE_EXTRA_RRECOMMENDS:append = " kernel-modules"
```

## meta-vk-distro/conf/distro/vk-bsp.conf
```bitbake
require conf/distro/poky.conf

DISTRO = "vk-bsp"
DISTROOVERRIDES = "poky:vk-bsp"

# Override these in poky based distros
DISTRO_FEATURES:append = " pam can"
DISTRO_FEATURES:remove = " x11"

MACHINE_ESSENTIAL_EXTRA_RDEPENDS += "kernel-image kernel-devicetree"

SANITY_TESTED_DISTROS ?= " \
	ubuntu-22.04 \n \
	"

IMAGE_INSTALL:append = " \
	${@bb.utils.contains('DISTRO_FEATURES', 'docker', ' packagegroup-docker', '',d)} \
"

IMAGE_INSTALL:append = " devicetree "
IMAGE_INSTALL:append = " packagegroup-base-wifi "

IMAGE_INSTALL:append = " ${@oe.utils.conditional("CONFIG_WLAN_CYW43439", "1", " \
        cyw43439-fw \
        wireless-regdb-static \
        iperf3 \
        connman connman-client \
        ", " ", d)} "

IMAGE_INSTALL:append:vk-d184280e = " ${@oe.utils.conditional("CONFIG_MXTAPP", "1", " mxt-app ", " ", d)} "

# Using Systemd as Initialization Manager
INIT_MANAGER = "systemd"

# Using systemd-journald without a traditional syslog daemon
VIRTUAL-RUNTIME_syslog = ""
VIRTUAL-RUNTIME_base-utils-syslog = ""
```

## meta-vk-distro/conf/distro/vk-clp.conf
```bitbake
require conf/distro/vk-bsp.conf

DISTRO = "vk-clp"
DISTROOVERRIDES = "poky:vk-bsp:vk-clp"

IMAGE_FEATURES:append = " vk-clp-tools ssh-server-openssh"

INHERIT:remove = "create-spdx"

IMAGE_INSTALL:append = " ${@oe.utils.conditional("CONFIG_QT_DEMO", "1", " packagegroup-qt6-examples ", " ", d)} "

FEATURE_PACKAGES_vk-clp-tools = " \
	packagegroup-vk-clp-tools-base \
	packagegroup-vk-clp-tools-utils \
"
```

## meta-vkg2l/conf/machine/vk-d184280e.conf
```bitbake
#@TYPE: Machine
#@NAME: Vekatech VK-D184280E machine
#@DESCRIPTION: RZ/G2LC platform

OVERRIDES_append = ":vk-d184280e"
SOC_FAMILY = "r9a07g044c"
require conf/machine/include/rzg2l-common.inc
require conf/machine/include/cip-core.inc
require conf/machine/include/cip-core-extend.inc

DEFAULTTUNE ?= "cortexa55"

TUNE_CONF ?= "conf/machine/include/tune-cortexa55.inc"
require ${TUNE_CONF}

PREFERRED_PROVIDER_virtual/kernel="linux-renesas"

FLASH_WRITER_BOARD ?= "VKCMG2LC"

TFA_PLATFORM ?= "g2l"
TFA_BOARD ?= "vkrzg2lc"
TFA_UBOOT ?= "1"
TFA_BUILD_TARGET ?= "bl2 bl31"
TFA_SPI_FLASH ?= "MX25L51245G"

BL2_BOOT_TARGET ?= "emmc"

BL2_ADJUST_VMA ?= "0x00011E00"
FIP_ADJUST_VMA ?= "0x0000"


UBOOT_CONFIG ??= "emmc"
UBOOT_CONFIG[emmc] = "vk-d184280e-emmc_defconfig"

UENV_FILE ?= "uEnv-vk-d184280e.txt"

# flash writer
EXTRA_IMAGEDEPENDS += " flash-writer"

# Supported devicetree
#KERNEL_DEVICETREE = " renesas/vkrzg2lc.dtb"
KERNEL_DTS = "vk-d184280e/vk-d184280e.dts"

KERNEL_DEVICETREE_OVERLAY  = " \
    vk-d184280e/overlays/vko-can.dts \
    vk-d184280e/overlays/vko-cm33.dts \
	vk-d184280e/overlays/vko-i2c2.dts \
	vk-d184280e/overlays/vko-qspi-mx25l51245g.dts \
	vk-d184280e/overlays/vko-rs485.dts \
	vk-d184280e/overlays/vko-udma.dts \
"

BSP_SOC = "RZG2LC"
BSP_BOARD = "VK-D184280E/G2LC-v2.0"

#ENABLE_SPD_OPTEE = '1'
#ENABLE_RZ_SCE    = '1'

IMAGE_BOOT_FILES = " \
	bl2_bp_emmc-${MACHINE}.bin \
	fip_emmc-${MACHINE}.bin \
	bl2_bp_emmc-${MACHINE}.srec \
	fip_emmc-${MACHINE}.srec \
	Flash_Writer_SCIF_VKCMG2LC_DDR4_2GB_1PCS.mot \
"
# generate wic image
#IMAGE_FSTYPES_remove = "tar.gz tar.bz2 wic.gz wic.bz2"
IMAGE_FSTYPES_append = " tar.xz wic wic.xz wic.bmap tar.gz tar.bz2 wic.gz wic.bz2"
IMAGE_BOOT_FILES += " Image vk-d184280e.dtb"

# Deploy the uEnv.txt to the /boot directory
WKS_FILE_DEPENDS_append = " uenv"
IMAGE_BOOT_FILES += " uEnv.txt"
IMAGE_BOOT_FILES += " readme.txt"

# Support DTB Overlay files
IMAGE_BOOT_FILES += " overlays/*;overlays/"
#IMAGE_BOOT_FILES += " cm33/*;cm33/"

WKS_DEFAULT_FILE:vk-d184280e = " ${@oe.utils.conditional("CONFIG_WKS_eMMC", "1", "image-vkboard-mmc0.wks ", " image-vkboard-sdhi1.wks ", d)} " 

# Ship kernel modules
MACHINE_ESSENTIAL_EXTRA_RRECOMMENDS_append = " kernel-modules"

WIC_INPUT_DEPENDS = "firmware-pack:do_deploy flash-writer:do_deploy"

CONFIG_MXTAPP ?= "1"
CONFIG_WLAN_CYW43439 ?= "1"

#INIT_MANAGER = "systemd"
DISTRO_FEATURES:append:vk-d184280e = " polkit"
```

## meta-vkg2l/conf/machine/vkrzg2lc.conf
```bitbake
#@TYPE: Machine
#@NAME: Vekatech VKRZG2LC machine
#@DESCRIPTION: RZ/G2LC platform

OVERRIDES_append = ":vkrzg2lc"
SOC_FAMILY = "r9a07g044c"
require conf/machine/include/rzg2l-common.inc
require conf/machine/include/cip-core.inc
require conf/machine/include/cip-core-extend.inc

DEFAULTTUNE ?= "cortexa55"

TUNE_CONF ?= "conf/machine/include/tune-cortexa55.inc"
require ${TUNE_CONF}

PREFERRED_PROVIDER_virtual/kernel="linux-renesas"

FLASH_WRITER_BOARD ?= "VKRZG2LC"

TFA_PLATFORM ?= "g2l"
TFA_BOARD ?= "vkrzg2lc"
TFA_UBOOT ?= "1"
TFA_BUILD_TARGET ?= "bl2 bl31"
TFA_SPI_FLASH ?= "MX25L51245G"

BL2_BOOT_TARGET ?= "qspi emmc"

BL2_ADJUST_VMA ?= "0x00011E00"
FIP_ADJUST_VMA ?= "0x0000"


UBOOT_CONFIG ??= "qspi emmc"
UBOOT_CONFIG[qspi] = "vkrzg2lc-qspi_defconfig"
UBOOT_CONFIG[emmc] = "vkrzg2lc-emmc_defconfig"

UENV_FILE ?= "uEnv-vkrzg2lc.txt"

# flash writer
EXTRA_IMAGEDEPENDS += " flash-writer"

# Supported devicetree
#KERNEL_DEVICETREE = " renesas/vkrzg2lc.dtb"
KERNEL_DTS = "vkrzg2lc/vkrzg2lc.dts"

KERNEL_DEVICETREE_OVERLAY  = " \
    vkrzg2lc/overlays/vkrz-audio.dts \
    vkrzg2lc/overlays/vkrz-can.dts \
    vkrzg2lc/overlays/vkrz-cm33.dts \
	vkrzg2lc/overlays/vkrz-csi-imx219.dts \
	vkrzg2lc/overlays/vkrz-dsi-av_disp2.dts \
	vkrzg2lc/overlays/vkrz-dsi-kd070hdfia030.dts \
	vkrzg2lc/overlays/vkrz-dsi-kd101wxfid045.dts \
	vkrzg2lc/overlays/vkrz-dsi-vklcd-ee0700.dts \
	vkrzg2lc/overlays/vkrz-dsi-vklcd07.dts \
	vkrzg2lc/overlays/vkrz-exp-i2c2.dts \
	vkrzg2lc/overlays/vkrz-exp-i2c3.dts \
	vkrzg2lc/overlays/vkrz-exp-pwm0.dts \
	vkrzg2lc/overlays/vkrz-exp-pwm1.dts \
	vkrzg2lc/overlays/vkrz-exp-scfi1.dts \
	vkrzg2lc/overlays/vkrz-exp-scfi1_rst_cts.dts \
	vkrzg2lc/overlays/vkrz-exp-scfi3.dts \
	vkrzg2lc/overlays/vkrz-exp-spi1.dts \
	vkrzg2lc/overlays/vkrz-udma.dts \
"

BSP_SOC = "RZG2LC"
BSP_BOARD = "VK-RZ/G2LC-v1.0"

#ENABLE_SPD_OPTEE = '1'
#ENABLE_RZ_SCE    = '1'

IMAGE_BOOT_FILES = " \
	bl2_bp_qspi-${MACHINE}.bin \
	bl2_bp_emmc-${MACHINE}.bin \
	fip_emmc-${MACHINE}.bin \
    fip_qspi-${MACHINE}.bin \
	bl2_bp_qspi-${MACHINE}.srec \
	bl2_bp_emmc-${MACHINE}.srec \
	fip_emmc-${MACHINE}.srec \
	fip_qspi-${MACHINE}.srec \
	Flash_Writer_SCIF_VKRZG2LC_DDR4_2GB_1PCS.mot \
"
# generate wic image
IMAGE_FSTYPES_remove = "tar.gz tar.bz2 wic.gz wic.bz2"
IMAGE_FSTYPES_append = " tar.xz wic wic.xz wic.bmap"
IMAGE_BOOT_FILES += " Image vkrzg2lc.dtb"

# Deploy the uEnv.txt to the /boot directory
WKS_FILE_DEPENDS_append = " uenv"
IMAGE_BOOT_FILES += " uEnv.txt"
IMAGE_BOOT_FILES += " readme.txt"

# Support DTB Overlay files
IMAGE_BOOT_FILES += " overlays/*;overlays/"
#IMAGE_BOOT_FILES += " cm33/*;cm33/"

WKS_DEFAULT_FILE:vkrzg2lc = " ${@oe.utils.conditional("CONFIG_WKS_eMMC", "1", "image-vkboard-mmc0.wks", "image-vkrboard-sdhi1.wks", d)} " 

# Ship kernel modules
MACHINE_ESSENTIAL_EXTRA_RRECOMMENDS_append = " kernel-modules"

WIC_INPUT_DEPENDS = "firmware-pack:do_deploy flash-writer:do_deploy"
```

## meta-vkg2l/docs/template/conf/bblayers.conf.sample
```bitbake
# POKY_BBLAYERS_CONF_VERSION is increased each time build/conf/bblayers.conf
# changes incompatibly
POKY_BBLAYERS_CONF_VERSION = "2"

BBPATH = "${TOPDIR}"
BBFILES ?= ""

QT_LAYER = "${@os.path.isdir("${TOPDIR}/../meta-qt5")}"
RZ_FEATURE_CODEC = "${@os.path.isdir("${TOPDIR}/../meta-rz-features/meta-rz-codecs")}"
RZ_FEATURE_GRAPHICS = "${@os.path.isdir("${TOPDIR}/../meta-rz-features/meta-rz-graphics")}"
VIRTUALIZATION_LAYER = "${@os.path.isdir("${TOPDIR}/../meta-virtualization")}"

RZ_FEATURE_MULTIOS = "${@os.path.isdir("${TOPDIR}/../meta-rz-features/meta-rz-multi-os/meta-rzg2l")}"
RZ_FEATURE_HTML5 = "${@os.path.isdir("${TOPDIR}/../meta-browser/meta-chromium")}"


BBLAYERS ?= " \
  ${TOPDIR}/../meta-gplv2 \
  ${TOPDIR}/../poky/meta \
  ${TOPDIR}/../poky/meta-poky \
  ${TOPDIR}/../poky/meta-yocto-bsp \
  ${TOPDIR}/../meta-renesas/meta-rz-common \
  ${TOPDIR}/../meta-renesas/meta-rzg2l \
  ${TOPDIR}/../meta-vkboards/meta-vk-common \
  ${TOPDIR}/../meta-vkboards/meta-vkg2l \
  ${TOPDIR}/../meta-openembedded/meta-oe \
  ${TOPDIR}/../meta-openembedded/meta-python \
  ${TOPDIR}/../meta-openembedded/meta-multimedia \
  ${@'${TOPDIR}/../meta-qt5' if '${QT_LAYER}' == 'True' else ''} \
  ${@'${TOPDIR}/../meta-rz-features/meta-rz-codecs' if '${RZ_FEATURE_CODEC}' == 'True' else ''} \
  ${@'${TOPDIR}/../meta-rz-features/meta-rz-graphics' if '${RZ_FEATURE_GRAPHICS}' == 'True' else ''} \
  ${@'${TOPDIR}/../meta-rz-features/meta-rz-multi-os/meta-rzg2l' if '${RZ_FEATURE_MULTIOS}' == 'True' else ''} \
  ${@'${TOPDIR}/../meta-clang' if '${RZ_FEATURE_HTML5}' == 'True' else ''} \
  ${@'${TOPDIR}/../meta-browser/meta-chromium' if '${RZ_FEATURE_HTML5}' == 'True' else ''} \
  ${@'${TOPDIR}/../meta-openembedded/meta-networking' if '${RZ_FEATURE_HTML5}' == 'True' else ''} \
  "
```
