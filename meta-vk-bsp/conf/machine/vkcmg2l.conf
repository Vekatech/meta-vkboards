## meta-vkv2l/conf/machine/vkcmv2l.conf
```bitbake
#@TYPE: Machine
#@NAME: Vekatech VK-CMRZ/V2L machine
#@DESCRIPTION: RZ/V2L platform

OVERRIDES_append = ":vkcmv2l"

SOC_FAMILY = "r9a07g054l"
require conf/machine/include/rzv2l-common.inc
require conf/machine/include/cip-core.inc
require conf/machine/include/cip-core-extend.inc

DEFAULTTUNE ?= "cortexa55"

TUNE_CONF ?= "conf/machine/include/tune-cortexa55.inc"
require ${TUNE_CONF}

PREFERRED_PROVIDER_virtual/kernel="linux-renesas"

UBOOT_CONFIG ??= "vkcmv2l"
UBOOT_CONFIG[vkcmv2l] = "vkcmv2l_defconfig"
#UBOOT_CONFIG[vkcmv2l] = "vkcmv2l-sf_defconfig"


# flash writer
EXTRA_IMAGEDEPENDS += " flash-writer"

# Supported devicetree
KERNEL_DEVICETREE = " renesas/vkcmv2l.dtb"

KERNEL_DEVICETREE_OVERLAY  = " \
    renesas/overlays-vkcmv2l/vkcmx2l-carrier.dtbo \
    renesas/overlays-vkcmv2l/vkrz-dsi-kd070hdfia030.dtbo \
    renesas/overlays-vkcmv2l/vkrz-dsi-kd101wxfid045.dtbo \
    renesas/overlays-vkcmv2l/vkrz-exp-riic2_100.dtbo \
    renesas/overlays-vkcmv2l/vkrz-exp-riic2_400.dtbo \
    renesas/overlays-vkcmv2l/vkrz-exp-rspi1.dtbo \
    renesas/overlays-vkcmv2l/vkrz-exp-scfi3.dtbo \
"

BSP_SOC = "RZV2L"
BSP_BOARD = "VK-CMRZ/V2L-v2.0"

#ENABLE_SPD_OPTEE = '1'
#ENABLE_RZ_SCE    = '1'

IMAGE_BOOT_FILES = " \
	bl2_bp-${MACHINE}.bin \
	fip-${MACHINE}.bin \
	bl2_bp-${MACHINE}.srec \
	fip-${MACHINE}.srec \
	Flash_Writer_SCIF_VKCMV2L_DDR4_2GB_1PCS.mot \
"
# generate wic image
IMAGE_FSTYPES_remove = "tar.gz tar.bz2 wic.gz wic.bz2"
IMAGE_FSTYPES_append = " tar.xz wic wic.xz wic.bmap"
IMAGE_BOOT_FILES += " Image vkcmv2l.dtb"

# Deploy the uEnv.txt to the /boot directory
WKS_FILE_DEPENDS_append = " uenv"
IMAGE_BOOT_FILES += " uEnv.txt"
IMAGE_BOOT_FILES += " readme.txt"
IMAGE_BOOT_FILES += " ${@oe.utils.conditional("CONFIG_OPENCVA", "1", " OpenCV_Bin.bin", "", d)} "

# Support DTB Overlay files
IMAGE_BOOT_FILES += " overlays/*;overlays/"
#IMAGE_BOOT_FILES += " cm33/*;cm33/"

WKS_DEFAULT_FILE = " ${@oe.utils.conditional("CONFIG_WKS_eMMC", "1", " image-vkboard-mmc0.wks ", " image-vkboard-sdhi1.wks ", d)} " 

# Ship kernel modules
MACHINE_ESSENTIAL_EXTRA_RRECOMMENDS_append = " kernel-modules"

WIC_INPUT_DEPENDS = "firmware-pack:do_deploy flash-writer:do_deploy"
```
