/*
 * Copyright 2023 Vekatech
 *
 * This program is free software; you can redistribute it and/or
 * modify it under the terms of the GNU General Public License
 * as published by the Free Software Foundation; either version 2
 * of the License, or (at your option) any later version.
 *
 * This program is distributed in the hope that it will be useful,
 * but WITHOUT ANY WARRANTY; without even the implied warranty of
 * MERCHANTABILITY or FITNESS FOR A PARTICULAR PURPOSE. See the
 * GNU General Public License for more details.
 */

/dts-v1/;
/plugin/;

#include <dt-bindings/pinctrl/rzg2l-pinctrl.h>

&pinctrl {
	spi0_pins: spi0 {
		pinmux = <RZG2L_PORT_PINMUX(15, 0, 1)>, /* CK */
			 <RZG2L_PORT_PINMUX(15, 1, 1)>, /* MOSI */
			 <RZG2L_PORT_PINMUX(15, 2, 1)>, /* MISO */
			 <RZG2L_PORT_PINMUX(15, 3, 1)>; /* SSL */
	};
};

&spi0 {
	pinctrl-0 = <&spi0_pins>;
	pinctrl-names = "default";
	dmas = <&dmac 0x2e95>, <&dmac 0x2e96>;
	dma-names = "tx", "rx";
	status = "okay";

	#address-cells = <1>;
	#size-cells = <0>;
	spidev@0 {
		compatible = "semtech,sx1301";
		reg = <0>;
		spi-max-frequency = <2000000>;
	};
};


