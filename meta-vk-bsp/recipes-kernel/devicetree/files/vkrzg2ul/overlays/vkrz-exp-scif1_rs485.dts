/*
 * Copyright 2025 Vekatech
 *
 * This program is free software; you can redistribute it and/or
 * modify it under the terms of the GNU General Public License
 * as published by the Free Software Foundation; either version 2
 * of the License, or (at your option) any later version.
 *
 * This program is distributed in the hope that it will be useful,
 * but WITHOUT ANY WARRANTY; without even the implied warranty of
 * MERCHANTABILITY or FITNESS FOR A PARTICULAR PURPOSE. See the
 * GNU General Public License for more details.
 */

/dts-v1/;
/plugin/;

#include <dt-bindings/pinctrl/rzg2l-pinctrl.h>
#include <dt-bindings/gpio/gpio.h>

&scif1 {
	pinctrl-0 = <&scif1_pins>;
	pinctrl-names = "default";

	rs485-sw-rts;
	gpios = <&pinctrl RZG2L_GPIO(16, 1) GPIO_ACTIVE_LOW>;
	status = "okay";
};

&pinctrl {
	scif1_pins: scif1 {
		pinmux = <RZG2L_PORT_PINMUX(14, 0, 1)>, /* TxD */
			 <RZG2L_PORT_PINMUX(14, 1, 1)>; /* RxD */
	};
};
