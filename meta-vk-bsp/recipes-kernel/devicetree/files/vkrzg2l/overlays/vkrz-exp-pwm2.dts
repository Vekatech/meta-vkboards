/*
 * Copyright 2023 Vekatech
 *
 * This program is free software; you can redistribute it and/or
 * modify it under the terms of the GNU General Public License
 * as published by the Free Software Foundation; either version 2
 * of the License, or (at your option) any later version.
 *
 * This program is distributed in the hope that it will be useful,
 * but WITHOUT ANY WARRANTY; without even the implied warranty of
 * MERCHANTABILITY or FITNESS FOR A PARTICULAR PURPOSE. See the
 * GNU General Public License for more details.
 */

/dts-v1/;
/plugin/;

#include <dt-bindings/pinctrl/rzg2l-pinctrl.h>

&gpt4 {
	status = "okay";

	pinctrl-0 = <&gpt4_pins>;
	pinctrl-names = "default";
	channel="channel_B";
};

&pinctrl {
	gpt4_pins: gpt4 {
		pinmux = <RZG2L_PORT_PINMUX(15, 1, 3)>; /* Channel B */
	};
};
