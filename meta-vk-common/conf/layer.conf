## meta-vk-common/conf/layer.conf
```bitbake
# We have a conf and classes directory, add to BBPATH
BBPATH .= ":${LAYERDIR}"

# We have recipes-* directories, add to BBFILES
BBFILES += "${LAYERDIR}/recipes-*/*/*.bb \
            ${LAYERDIR}/recipes-*/*/*.bbappend \
            ${LAYERDIR}/recipes-*/*/*/*.bb \
            ${LAYERDIR}/recipes-*/*/*/*.bbappend"

BBFILE_COLLECTIONS += "vk-common"
BBFILE_PATTERN_vk-common= "^${LAYERDIR}/"
BBFILE_PRIORITY_vk-common = "17"

LAYERDEPENDS_vk-common = "rz-common"
LAYERSERIES_COMPAT_vk-common = "dunfell"

HOSTTOOLS += "xz"
```

## meta-vkg2l/conf/layer.conf
```bitbake
# We have a conf and classes directory, add to BBPATH
BBPATH .= ":${LAYERDIR}"

# We have recipes-* directories, add to BBFILES
BBFILES += "${LAYERDIR}/recipes-*/*/*.bb \
            ${LAYERDIR}/recipes-*/*/*.bbappend \
            ${LAYERDIR}/recipes-*/*/*/*.bb \
            ${LAYERDIR}/recipes-*/*/*/*.bbappend \
        "

BBFILE_COLLECTIONS += "vkg2l"
BBFILE_PATTERN_vkg2l= "^${LAYERDIR}/"
BBFILE_PRIORITY_vkg2l = "17"

LAYERDEPENDS_vkg2l = "rz-common rzg2l vk-common"
LAYERSERIES_COMPAT_vkg2l = "dunfell"

HOSTTOOLS += "xz"
```

## meta-vkg2l/conf/machine/vkcmg2lc.conf
```bitbake
#@TYPE: Machine
#@NAME: Vekatech VKCMG2LC machine
#@DESCRIPTION: RZ/G2LC platform

OVERRIDES_append = ":vkcmg2lc"
SOC_FAMILY = "r9a07g044c"
require conf/machine/include/rzg2l-common.inc
require conf/machine/include/cip-core.inc
require conf/machine/include/cip-core-extend.inc

DEFAULTTUNE ?= "cortexa55"

TUNE_CONF ?= "conf/machine/include/tune-cortexa55.inc"
require ${TUNE_CONF}

PREFERRED_PROVIDER_virtual/kernel="linux-renesas"

UBOOT_CONFIG ??= "vkcmg2lc"
UBOOT_CONFIG[vkcmg2lc] = "vkcmg2lc_defconfig"
#UBOOT_CONFIG[vkcmg2lc] = "vkcmg2lc-sf_defconfig"


# flash writer
EXTRA_IMAGEDEPENDS += " flash-writer"

# Supported devicetree
KERNEL_DEVICETREE = " renesas/vkcmg2lc.dtb"

KERNEL_DEVICETREE_OVERLAY  = " \
    renesas/overlays-vkcmg2lc/vkrz-cm-scif2.dtbo \
    renesas/overlays-vkcmg2lc/vkrz-cm-usb1.dtbo \
    renesas/overlays-vkcmg2lc/vkrz-cm33.dtbo \
	renesas/overlays-vkcmg2lc/vkrz-csi-ov5645.dtbo \
	renesas/overlays-vkcmg2lc/vkrz-dsi-kd070hdfia030.dtbo \
	renesas/overlays-vkcmg2lc/vkrz-dsi-kd101wxfid045.dtbo \
	renesas/overlays-vkcmg2lc/vkrz-qspi-mx25l51245g.dtbo \
	renesas/overlays-vkcmg2lc/vkrz-udma.dtbo \
"

BSP_SOC = "RZG2LC"
BSP_BOARD = "VK-CMRZ/G2LC-v1.0"

#ENABLE_SPD_OPTEE = '1'
#ENABLE_RZ_SCE    = '1'

IMAGE_BOOT_FILES = " \
	bl2_bp-${MACHINE}.bin \
    bl2_bp-${MACHINE}.srec \
	fip-${MACHINE}.bin \
	fip-${MACHINE}.srec \
	Flash_Writer_SCIF_VKCMG2LC_DDR4_2GB_1PCS.mot \
"
# generate wic image
IMAGE_FSTYPES_remove = "tar.gz tar.bz2 wic.gz wic.bz2"
IMAGE_FSTYPES_append = " tar.xz wic wic.xz wic.bmap"
IMAGE_BOOT_FILES += " Image vkcmg2lc.dtb"

# Deploy the uEnv.txt to the /boot directory
WKS_FILE_DEPENDS_append = " uenv"
IMAGE_BOOT_FILES += " uEnv.txt"
IMAGE_BOOT_FILES += " readme.txt"

# Support DTB Overlay files
IMAGE_BOOT_FILES += " overlays/*;overlays/"
#IMAGE_BOOT_FILES += " cm33/*;cm33/"

WKS_DEFAULT_FILE = " ${@oe.utils.conditional("CONFIG_WKS_eMMC", "1", " image-vkboard-mmc0.wks ", " image-vkboard-sdhi1.wks ", d)} " 

# Ship kernel modules
MACHINE_ESSENTIAL_EXTRA_RRECOMMENDS_append = " kernel-modules"

WIC_INPUT_DEPENDS = "firmware-pack:do_deploy flash-writer:do_deploy"
```

## meta-vkg2l/conf/machine/vkrzg2l.conf
```bitbake
#@TYPE: Machine
#@NAME: Vekatech VKRZG2L machine
#@DESCRIPTION: RZ/G2L platform

OVERRIDES_append = ":vkrzg2l"
SOC_FAMILY = "r9a07g044l"
require conf/machine/include/rzg2l-common.inc
require conf/machine/include/cip-core.inc
require conf/machine/include/cip-core-extend.inc

DEFAULTTUNE ?= "cortexa55"

TUNE_CONF ?= "conf/machine/include/tune-cortexa55.inc"
require ${TUNE_CONF}

PREFERRED_PROVIDER_virtual/kernel="linux-renesas"

UBOOT_CONFIG ??= "vkrzg2l"
UBOOT_CONFIG[vkrzg2l] = "vkrzg2l_defconfig"
#UBOOT_CONFIG[vkrzg2l] = "vkrzg2l-sf_defconfig"


# flash writer
EXTRA_IMAGEDEPENDS += " flash-writer"

# Supported devicetree
KERNEL_DEVICETREE = " renesas/vkrzg2l.dtb"

KERNEL_DEVICETREE_OVERLAY  = " \
    renesas/overlays-vkrzg2l/vkrz-cm33.dtbo \
    renesas/overlays-vkrzg2l/vkrz-csi-imx219.dtbo \
    renesas/overlays-vkrzg2l/vkrz-dsi-av_disp2.dtbo \
    renesas/overlays-vkrzg2l/vkrz-dsi-hdmi.dtbo \
   	renesas/overlays-vkrzg2l/vkrz-dsi-kd070hdfia030.dtbo \
    renesas/overlays-vkrzg2l/vkrz-dsi-kd101wxfid045.dtbo \
    renesas/overlays-vkrzg2l/vkrz-dsi-kd101wxfid045-ena.dtbo \
    renesas/overlays-vkrzg2l/vkrz-dsi-kd101wxfid045-pwr.dtbo \
    renesas/overlays-vkrzg2l/vkrz-dsi-vklcd-ee0700.dtbo \
    renesas/overlays-vkrzg2l/vkrz-dsi-vklcd07.dtbo \
    renesas/overlays-vkrzg2l/vkrz-exp-pwm0.dtbo \
    renesas/overlays-vkrzg2l/vkrz-exp-pwm1.dtbo \
    renesas/overlays-vkrzg2l/vkrz-exp-pwm2.dtbo \
    renesas/overlays-vkrzg2l/vkrz-exp-riic2.dtbo \
    renesas/overlays-vkrzg2l/vkrz-exp-rspi1.dtbo \
    renesas/overlays-vkrzg2l/vkrz-exp-scif2.dtbo \
    renesas/overlays-vkrzg2l/vkrz-exp-scif2_rts_cts.dtbo \
    renesas/overlays-vkrzg2l/vkrz-sdhi0-emmc.dtbo \
    renesas/overlays-vkrzg2l/vkrz-sdhi0-sdhi.dtbo \
"

BSP_SOC = "RZG2L"
BSP_BOARD = "VK-RZ/G2L-v2.0"

#ENABLE_SPD_OPTEE = '1'
#ENABLE_RZ_SCE    = '1'

IMAGE_BOOT_FILES = " \
	bl2_bp-${MACHINE}.bin \
	bl2_bp-${MACHINE}.srec \
	fip-${MACHINE}.bin \
	fip-${MACHINE}.srec \
	Flash_Writer_SCIF_VKRZG2L_DDR4_2GB_1PCS.mot \
"
# generate wic image
IMAGE_FSTYPES_remove = "tar.gz tar.bz2 wic.gz wic.bz2"
IMAGE_FSTYPES_append = " tar.xz wic wic.xz wic.bmap"
IMAGE_BOOT_FILES += " Image vkrzg2l.dtb"

# Deploy the uEnv.txt to the /boot directory
WKS_FILE_DEPENDS_append = " uenv"
IMAGE_BOOT_FILES += " uEnv.txt"
IMAGE_BOOT_FILES += " readme.txt"

# Support DTB Overlay files
IMAGE_BOOT_FILES += " overlays/*;overlays/"
#IMAGE_BOOT_FILES += " cm33/*;cm33/"

WKS_DEFAULT_FILE = " ${@oe.utils.conditional("CONFIG_WKS_eMMC", "1", " image-vkboard-mmc0.wks ", " image-vkboard-sdhi1.wks ", d)} " 

# Ship kernel modules
MACHINE_ESSENTIAL_EXTRA_RRECOMMENDS_append = " kernel-modules"

WIC_INPUT_DEPENDS = "firmware-pack:do_deploy flash-writer:do_deploy"
```

## meta-vkv2l/conf/layer.conf
```bitbake
# We have a conf and classes directory, add to BBPATH
BBPATH .= ":${LAYERDIR}"

# We have recipes-* directories, add to BBFILES
BBFILES += "${LAYERDIR}/recipes-*/*/*.bb \
            ${LAYERDIR}/recipes-*/*/*.bbappend \
            ${LAYERDIR}/recipes-*/*/*/*.bb \
            ${LAYERDIR}/recipes-*/*/*/*.bbappend \
        "

BBFILE_COLLECTIONS += "vkv2l"
BBFILE_PATTERN_vkv2l= "^${LAYERDIR}/"
BBFILE_PRIORITY_vkv2l = "17"

LAYERDEPENDS_vkv2l = "rz-common rzv2l vk-common"
LAYERSERIES_COMPAT_vkv2l = "dunfell"

HOSTTOOLS += "xz"
```
