// SPDX-License-Identifier: GPL-2.0
/*
 * Device Tree Source for the Vekatech (VKRZG2LC Dual Cortex-A55)
 *
 * Copyright (C) 2022 Vekatech.
 */

/dts-v1/;

#include "vkcmg2lc_common.dtsi"

/ {
	model = "Vekatech,vkcmg2lc_!G";
	compatible = "vekatech,vkcmg2lc", "renesas,r9a07g044", "renesas,r9a07g044c2";

	memory@48000000 {
		device_type = "memory";
		/* first 128MB is reserved for secure area. */
		reg = <0x0 0x48000000 0x0 0x38000000>;
	};
};
